#include "pico/stdlib.h"
#include "hardware/spi.h"
#include <malloc.h>
#include <stdlib.h>

#include "grapher.h"
#include "elements.h"
#include "menu.h"
#include "sequences.h"
#include "settings.h"
#include "Solver.h"
#include "Calc.h"
#include "ui.h"
#include "Tools.h"
#include "Converter.h"
#include "python.h"
#include "Tamagotchi.h"
#include "colors.h"
#include "exam_mode.h"
#include "tz_config.h"
#include "stats_app.h"
#include "ui_kit.h"
#include <string.h>
#include <stdio.h>
#include <string>
int x_cursor = 0;
int y_cursor = 0;

int main()
{

    stdio_init_all();
    sleep_ms(500); // laisse le temps à l'USB de se connecter

    /* Initialise the display early so the exam-mode splash (below) can draw
     * before the rest of the app is set up. */
    gpio_init(PIN_CS);
    gpio_set_dir(PIN_CS, GPIO_OUT);
    gpio_init(PIN_DC);
    gpio_set_dir(PIN_DC, GPIO_OUT);
    gpio_init(PIN_RST);
    gpio_set_dir(PIN_RST, GPIO_OUT);
    spi_init(spi0, 62500000);
    gpio_set_function(PIN_SCK, GPIO_FUNC_SPI);
    gpio_set_function(PIN_MOSI, GPIO_FUNC_SPI);
    ili_init();

#ifdef EXAM_RECOVERY
    exam_mode_disable();
#endif

    volatile bool exam_mode = exam_mode_is_active(); // volatile : relu apres longjmp
    if (exam_mode)
    {
        exam_mode_enter();
        fill_screen(COLOR_GREEN);
        draw_char(50, 60, (char *)"MODE EXAMEN", COLOR_BLACK, COLOR_GREEN, 3);
        draw_char(100, 30, (char *)"Active - LED GPIO26", COLOR_BLACK, COLOR_GREEN, 2);
        flush_display();
        sleep_ms(2000);
        fill_screen(BACKGROUND_COLOR);
    }

    /* Charge les réglages persistant (unité d'angle, décimales, luminosité).
     * Placé après la gestion du mode examen : en examen, les valeurs par
     * défaut sont appliquées et ne sont pas rechargées. */
    settings_load();

    uint16_t img1[] = {44407,44407,44407,44407,44407,44407,44407,44407,44407,44407,44407,44407,44407,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44407,44407};
    uint16_t img2[] = {44439 ,44439 ,44439 ,44439 ,44439 ,44439 ,44439 ,44439 ,44439 ,44439 ,44439 ,44439 ,44439 ,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44439 ,44439};
    uint16_t img3[] = {40213,40213,40213,40213,40213,40213,40213,40213,40213,40213,40213,40213,40213,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40213,40213};
    uint16_t img4[] = {44407,44407,44407,44407,44407,44407,44407,44407,44407,44407,44407,44407,44407,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44407,44407};
    uint16_t img5[] = {44407 ,44407 ,44407 ,44407 ,44407 ,44407 ,44407 ,44407 ,44407 ,44407 ,44407 ,44407 ,44407 ,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44407 ,44407};
    uint16_t img6[] = {44407 ,44407 ,44407 ,44407 ,44407 ,44407 ,44407 ,44407 ,44407 ,44407 ,44407 ,44407 ,44407 ,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44407 ,44407};
    uint16_t img7[] = {44407,44407,44407,44407,44407,44407,44407,44407,44407,44407,44407,44407,44407,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44407,4407 };
    uint16_t img8[] = {65535,65535,65535,65535,65535,65535,65535,65535,65535,65535,65535,65535,65535,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65535,65535};
    uint16_t *img_calc = (uint16_t *)malloc(sizeof(uint16_t) * 79 * 79);

    for (int i = 0; i < 79 * 79; i++)
    {
        img_calc[i] = img1[i];
    }

    uint16_t *img_solver = (uint16_t *)malloc(sizeof(uint16_t) * 79 * 79);
    for (int i = 0; i < 79 * 79; i++)
    {
        img_solver[i] = img2[i];
    }
    uint16_t *img_param = (uint16_t *)malloc(sizeof(uint16_t) * 79 * 79);
    for (int i = 0; i < 79 * 79; i++)
    {
        img_param[i] = img3[i];
    }

    uint16_t *img_graph = (uint16_t *)malloc(sizeof(uint16_t) * 79 * 79);
    for (int i = 0; i < 79 * 79; i++)
    {
        img_graph[i] = img4[i];
    }
    uint16_t *img_periodic = (uint16_t *)malloc(sizeof(uint16_t) * 79 * 79);
    for (int i = 0; i < 79 * 79; i++)
    {
        img_periodic[i] = img5[i];
    }
    uint16_t *img_sequence = (uint16_t *)malloc(sizeof(uint16_t) * 79 * 79);
    for (int i = 0; i < 79 * 79; i++)
    {
        img_sequence[i] = img6[i];
    }
   uint16_t *img_convert = (uint16_t *)malloc(sizeof(uint16_t) * 79 * 79);
    for (int i = 0; i < 79 * 79; i++)
    {
        img_convert[i] = img7[i];
    }

   uint16_t *img_py = (uint16_t *)malloc(sizeof(uint16_t) * 79 * 79);
    for (int i = 0; i < 79 * 79; i++)
    {
        img_py[i] = img8[i];
    }
    /* Applis du menu principal : grille de 3 colonnes, deux rangees visibles. */
    const int MENU_N = 11;
    uint16_t **arr_img = (uint16_t **)malloc(sizeof(uint16_t *) * MENU_N);
    arr_img[0] = img_calc;
    arr_img[1] = img_graph;
    arr_img[2] = img_solver;
    arr_img[3] = img_param;
    arr_img[4] = img_sequence;
    arr_img[5] = img_periodic;

    arr_img[6] = img_convert;
    arr_img[7] = img_py;
    arr_img[8] = NULL;  /* Tamagotchi, Statistiques, Probabilites : icones */
    arr_img[9] = NULL;  /* dessinees a la volee (uk_draw_icon). */
    arr_img[10] = NULL;
    const int menu_icon[MENU_N] = {-1, -1, -1, -1, -1, -1, -1, -1,
                                   UK_ICON_TAMAGOTCHI, UK_ICON_STATS, UK_ICON_PROBA};

    init_keypad();

    text_box **menu_button = (text_box **)malloc(sizeof(text_box *) * MENU_N);
    volatile int select_item_menu = 0; // volatile : relu apres longjmp

    for (int i = 0; i < MENU_N; i++)
    {
        int x = 18 + 101 * (i % 3);
        int y = 119 - 103 * (i / 3); /* rangee 0 en haut ; decalee a l'affichage */
        menu_button[i] = create_text_box(x, y, 83, 83, 2, false);
        menu_button[i]->col = 44439;
    }
    static const char *menu_names[MENU_N] = {
        "Calculatrice", "Grapheur", "Solveur d'equation",
        "Parametres", "Suites", "Tableau periodique",
        "Convertisseur", "Python", "Tamagotchi",
        "Statistiques", "Probabilites"};
    for (int i = 0; i < MENU_N; i++)
    {
        menu_button[i]->text = (char *)menu_names[i];
        menu_button[i]->t_size = (int)strlen(menu_names[i]);
    }
    fill_screen(BACKGROUND_COLOR);
    int start = 0;

    /* Point de retour du bouton HOME (voir home_check dans Tools.cpp). */
    if (setjmp(g_home_jmp) != 0)
    {
        /* Les fichiers Python sont sauvegardes comme a la sortie normale. */
        if (select_item_menu == 7)
            python_files_save();
        /* Vide les repetitions de HOME si la touche est maintenue, sinon le
         * menu principal lancerait le combo du mode examen. */
        for (int k = 0; k < 6; k++)
        {
            sleep_ms(50);
            while (scan_keypad_nowait() != -1)
            {
            }
        }
        fill_screen(BACKGROUND_COLOR);
    }

    int shown_top = -1;
    while (true)
    {
        /* Premiere rangee visible : celle au-dessus de la selection. */
        int top_row = select_item_menu / 3 - 1;
        if (top_row < 0)
            top_row = 0;
        if (top_row != shown_top)
        {
            fill_screen(BACKGROUND_COLOR);
            shown_top = top_row;
        }
        int shift = 103 * top_row;
        for (int i = 3 * top_row; i < 3 * top_row + 6 && i < MENU_N; i++)
        {
            display_text_box(menu_button[i], shift, -77, i == select_item_menu);
            if (arr_img[i])
            {
                draw_buffer(menu_button[i]->y + 2 + shift, menu_button[i]->x + 2, 79, 79, arr_img[i]);
            }
#ifdef OPENCALC_WASM
            if (arr_img[i])
            {
                draw_image(menu_button[i]->y + 2 + shift, menu_button[i]->x + 2, 79, 79, arr_img[i], 0x0000);
            }
#endif
            if (!arr_img[i] && menu_icon[i] >= 0)
                uk_draw_icon(menu_icon[i], menu_button[i]->x + 2,
                             SCREEN_HEIGHT - (menu_button[i]->y + 2 + shift) - 79);
        }

        if (exam_mode)
        {
            exam_mode_led_update();
        }

        //  draw_image(120,20,79,79,img,44439);
        display_battery(222, 286, 2);

        draw_char(230, 160 - 9 * 5, "Main menu", 0x0000, BACKGROUND_COLOR, 2);
        flush_display();
        int last_pressed = scan_keypad();
        while (last_pressed == -1)
        {
            if (exam_mode)
            {
                exam_mode_led_update();
            }
            last_pressed = scan_keypad();
        }
        start = to_ms_since_boot(get_absolute_time());
        switch (last_pressed)
        {

        case DOWN: // down
            select_item_menu = (select_item_menu + 3 < MENU_N) ? select_item_menu + 3 : select_item_menu % 3;
            fill_rect(100, 0, 18, 320, BACKGROUND_COLOR);
            fill_rect(0, 0, 18, 320, BACKGROUND_COLOR);

            break;

        case UP: // up
            if (select_item_menu >= 3)
                select_item_menu -= 3;
            else
            {
                /* Remonte en boucle sur la derniere rangee de la meme colonne. */
                int col = select_item_menu % 3;
                select_item_menu = col + 3 * ((MENU_N - 1 - col) / 3);
            }
            fill_rect(100, 0, 18, 320, BACKGROUND_COLOR);
            fill_rect(0, 0, 18, 320, BACKGROUND_COLOR);

            break;

        case RIGHT: // right
            select_item_menu = (select_item_menu + 1) % MENU_N;
            fill_rect(100, 0, 18, 320, BACKGROUND_COLOR);
            fill_rect(0, 0, 18, 320, BACKGROUND_COLOR);

            break;

        case LEFT: // left
            select_item_menu = (select_item_menu - 1 + MENU_N) % MENU_N;
            fill_rect(100, 0, 18, 320, BACKGROUND_COLOR);
            fill_rect(0, 0, 18, 320, BACKGROUND_COLOR);

            break;
        case OK: // ok
            g_home_armed = true; // HOME dans l'appli => retour ici
            switch (select_item_menu)
            {
            case 0:
                Calc();
                break;
            case 1:
                Grapher();
                break;
            case 2:
                Solver();
                break;

            case 3:
                settings();
                break;
            case 4:
                Sequencer();
                break;

            case 5:
                display_table();
                break;
            case 6:
                Converter();
                break;
            case 7:
                python_app();
                break;
            case 8:
                Tamagotchi();
                break;
            case 9:
                Statistics();
                break;
            case 10:
                Probabilities();
                break;

            default:
                break;
            }
            g_home_armed = false;
            fill_screen(BACKGROUND_COLOR);
            shown_top = -1;

            break;

        case HOME:
            if (!exam_mode)
            {
                if (exam_mode_combo_confirmed())
                {
                    exam_mode_activate(120);
                    exam_mode = true;
                    exam_mode_enter();
                    fill_screen(BACKGROUND_COLOR);
                }
                else
                {
                    fill_screen(BACKGROUND_COLOR);
                }
            }
            break;

        default:
            break;
        }

        if (select_item_menu < 0)
            select_item_menu += MENU_N;
    }
}